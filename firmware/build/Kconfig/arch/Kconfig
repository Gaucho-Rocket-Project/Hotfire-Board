## firmware/build/Kconfig/arch/Kconfig
```kconfig
# Load Zephyr Arch Kconfig descriptions.
osource "/Users/jacob/zephyrproject/zephyr/arch/tricore/Kconfig"
osource "/Users/jacob/zephyrproject/zephyr/arch/hexagon/Kconfig"
osource "/Users/jacob/zephyrproject/zephyr/arch/rx/Kconfig"
osource "/Users/jacob/zephyrproject/zephyr/arch/x86/Kconfig"
osource "/Users/jacob/zephyrproject/zephyr/arch/xtensa/Kconfig"
osource "/Users/jacob/zephyrproject/zephyr/arch/sparc/Kconfig"
osource "/Users/jacob/zephyrproject/zephyr/arch/riscv/Kconfig"
osource "/Users/jacob/zephyrproject/zephyr/arch/posix/Kconfig"
osource "/Users/jacob/zephyrproject/zephyr/arch/openrisc/Kconfig"
osource "/Users/jacob/zephyrproject/zephyr/arch/mips/Kconfig"
osource "/Users/jacob/zephyrproject/zephyr/arch/arm64/Kconfig"
osource "/Users/jacob/zephyrproject/zephyr/arch/arm/Kconfig"
osource "/Users/jacob/zephyrproject/zephyr/arch/arc/Kconfig"
```

## firmware/build/Kconfig/boards/Kconfig.defconfig
```kconfig
# Load Zephyr board defconfig descriptions.
osource "/Users/jacob/zephyrproject/zephyr/boards/st/nucleo_l496zg/Kconfig.defconfig"
```

## firmware/build/Kconfig/boards/Kconfig.nucleo_l496zg
```kconfig
# Load board Kconfig descriptions.
osource "/Users/jacob/zephyrproject/zephyr/boards/st/nucleo_l496zg/Kconfig.nucleo_l496zg"
```
